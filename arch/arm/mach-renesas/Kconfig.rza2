## arch/arm/mach-renesas/Kconfig.rza2
```kconfig
if RZA2

# required by the serial driver
config CPU_RZA2
	bool
	default y

choice
	prompt "Renesas RZ/A2 board select"

config TARGET_GRMANGO
	bool "GR-MANGO board"

endchoice

source "board/renesas/grmango/Kconfig"

endif
```

## board/renesas/grmango/Kconfig
```kconfig
if TARGET_GRMANGO

config SYS_BOARD
	default "grmango"

config SYS_VENDOR
	default "renesas"

config SYS_CONFIG_NAME
	default "grmango"

config GRMANGO_OCTARAM_SIZE
	hex "Size of the OctaRAM mapped at 0x60000000"
	default 0x800000
	help
	  The board carries a 16 MiB APS12808L, but the address conversion
	  of the RZ/A2M Octa memory controller drops bit 23 of the offset
	  (verified on the board: with DSR1 = 16 MiB, 0x60800000 aliases
	  0x60000000), so only 8 MiB can be memory mapped.

endif
```

## configs/grmango_netbsd_defconfig
```kconfig
CONFIG_ARM=y
CONFIG_ARCH_CPU_INIT=y
CONFIG_ARCH_RENESAS=y
CONFIG_TEXT_BASE=0x50000000
CONFIG_SYS_MALLOC_LEN=0x40000
CONFIG_SYS_MALLOC_F_LEN=0x800
CONFIG_ENV_SOURCE_FILE="grmango_netbsd"
CONFIG_NR_DRAM_BANKS=2
CONFIG_HAS_CUSTOM_SYS_INIT_SP_ADDR=y
CONFIG_CUSTOM_SYS_INIT_SP_ADDR=0x80300000
CONFIG_ENV_SIZE=0x2000
# CONFIG_OF_UPSTREAM is not set
CONFIG_DEFAULT_DEVICE_TREE="r7s9210-gr-mango"
CONFIG_RZA2=y
CONFIG_TARGET_GRMANGO=y
CONFIG_SYS_MONITOR_LEN=524288
CONFIG_SYS_LOAD_ADDR=0x80100000
CONFIG_SYS_CLK_FREQ=132000000
# CONFIG_EFI_LOADER is not set
# CONFIG_BOOTSTD is not set
CONFIG_BOOTDELAY=3
CONFIG_USE_BOOTARGS=y
CONFIG_BOOTARGS="root=ld0a"
CONFIG_USE_BOOTCOMMAND=y
CONFIG_BOOTCOMMAND="bootm ${kernel_flash} - ${fdt_flash}"
CONFIG_SYS_CBSIZE=256
CONFIG_SYS_PBSIZE=256
# CONFIG_DISPLAY_CPUINFO is not set
# CONFIG_DISPLAY_BOARDINFO is not set
# CONFIG_BOARD_EARLY_INIT_F is not set
CONFIG_HUSH_PARSER=y
CONFIG_BOARD_LATE_INIT=y
# CONFIG_CMD_ELF is not set
# CONFIG_CMD_XIMG is not set
# CONFIG_CMD_EDITENV is not set
# CONFIG_CMD_SAVEENV is not set
# CONFIG_CMD_LOADB is not set
# CONFIG_CMD_LOADS is not set
CONFIG_CMD_MEMTEST=y
CONFIG_CMD_CACHE=y
CONFIG_CMD_TIME=y
CONFIG_OF_CONTROL=y
# CONFIG_NET is not set
# CONFIG_MMC is not set
CONFIG_PINCTRL=y
CONFIG_SCIF_CONSOLE=y
CONFIG_TIMER=y
CONFIG_RENESAS_OSTM_TIMER=y
```

## configs/grpeach_netbsd_defconfig
```kconfig
CONFIG_ARM=y
CONFIG_ARCH_CPU_INIT=y
CONFIG_ARCH_RENESAS=y
CONFIG_TEXT_BASE=0x18000000
CONFIG_SYS_MALLOC_LEN=0x40000
CONFIG_SYS_MALLOC_F_LEN=0x800
CONFIG_ENV_SOURCE_FILE="grpeach_netbsd"
CONFIG_NR_DRAM_BANKS=1
CONFIG_HAS_CUSTOM_SYS_INIT_SP_ADDR=y
CONFIG_CUSTOM_SYS_INIT_SP_ADDR=0x20900000
CONFIG_ENV_SIZE=0x2000
CONFIG_DM_GPIO=y
CONFIG_DEFAULT_DEVICE_TREE="renesas/r7s72100-gr-peach"
CONFIG_RZA1=y
CONFIG_TARGET_GRPEACH=y
CONFIG_SYS_MONITOR_LEN=262144
CONFIG_SYS_LOAD_ADDR=0x20400000
CONFIG_SYS_CLK_FREQ=66666666
# CONFIG_EFI_LOADER is not set
# CONFIG_BOOTSTD is not set
CONFIG_BOOTDELAY=3
CONFIG_USE_BOOTARGS=y
CONFIG_BOOTARGS="root=ld0a"
CONFIG_USE_BOOTCOMMAND=y
CONFIG_BOOTCOMMAND="bootm ${kernel_flash} - ${fdt_flash}"
CONFIG_SYS_CBSIZE=256
CONFIG_SYS_PBSIZE=256
# CONFIG_DISPLAY_CPUINFO is not set
# CONFIG_DISPLAY_BOARDINFO is not set
# CONFIG_BOARD_EARLY_INIT_F is not set
CONFIG_HUSH_PARSER=y
# CONFIG_CMD_BDI is not set
# CONFIG_CMD_CONSOLE is not set
# CONFIG_CMD_ELF is not set
# CONFIG_CMD_XIMG is not set
# CONFIG_CMD_EDITENV is not set
# CONFIG_CMD_SAVEENV is not set
# CONFIG_CMD_RANDOM is not set
# CONFIG_CMD_LOADB is not set
# CONFIG_CMD_LOADS is not set
# CONFIG_CMD_PINMUX is not set
# CONFIG_CMD_ITEST is not set
# CONFIG_CMD_SETEXPR is not set
CONFIG_CMD_CACHE=y
CONFIG_OF_CONTROL=y
# CONFIG_NET is not set
CONFIG_RZA1_GPIO=y
# CONFIG_MMC is not set
CONFIG_PINCTRL=y
CONFIG_SCIF_CONSOLE=y
CONFIG_TIMER=y
CONFIG_RENESAS_OSTM_TIMER=y
```
